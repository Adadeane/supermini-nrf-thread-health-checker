## west.yml
```yaml
manifest:
  remotes:
    - name: zephyrproject-rtos
      url-base: https://github.com/zephyrproject-rtos

  defaults:
    remote: zephyrproject-rtos

  projects:
    - name: zephyr
      revision: v3.7.0
      import: true

  self:
    path: app
```
